## CMakeLists.txt
```
#
# Copyright (c) 2021 Nordic Semiconductor ASA
#
# SPDX-License-Identifier: Apache-2.0
#

cmake_minimum_required(VERSION 3.20)

set(SHIELD adafruit_2_8_tft_touch_v2)

find_package(Zephyr REQUIRED HINTS $ENV{ZEPHYR_BASE})

get_target_property(TFM_BINARY_DIR tfm TFM_BINARY_DIR)
configure_file(
  ${CMAKE_CURRENT_LIST_DIR}/../secure_partition/tfm_manifest_list.yaml.in
  ${CMAKE_CURRENT_BINARY_DIR}/secure_partition/tfm_manifest_list.yaml
)

set_property(TARGET zephyr_property_target
  APPEND PROPERTY TFM_CMAKE_OPTIONS
  -DTFM_EXTRA_MANIFEST_LIST_FILES=${CMAKE_CURRENT_BINARY_DIR}/secure_partition/tfm_manifest_list.yaml
  -DTFM_EXTRA_PARTITION_PATHS=${CMAKE_CURRENT_LIST_DIR}/../secure_partition
)

project(mycli)
add_definitions(-DNRF -DTFM)

target_sources(app PRIVATE
  src/main.c
  ../lib/secure_partition_interface.c
  ../lib/bls_hsm_ns.c
  ../lib/common.c
)

zephyr_library_include_directories(
  ../lib/
)

#add_library(testlib STATIC IMPORTED)
#target_link_libraries(app PUBLIC ${APPLICATION_SOURCE_DIR}/../lib/libblst.a)

target_include_directories(app PRIVATE
  $<TARGET_PROPERTY:tfm,TFM_BINARY_DIR>/install/interface/include
)

target_compile_definitions(app
    PRIVATE TFM_PARTITION_DUMMY_PARTITION
)

# To see type of fatal error in the log 
set_property(
TARGET zephyr_property_target
APPEND PROPERTY TFM_CMAKE_OPTIONS

# Use -O0. So GDB reports correct line numbers.
-DCMAKE_BUILD_TYPE=Debug

# Halt instead of rebooting on internal TF-M faults.
-DTFM_HALT_ON_CORE_PANIC=ON

# NB: Probably not enough MPU regions on nrf53 in Isolation level 2
-DNULL_POINTER_EXCEPTION_DETECTION=ON

# Add a debug function that logs the memory protection config, and
# then invoke it from the SPE with log_memory_protection() to see
# the memory protection configuration.
-DLOG_MEMORY_PROTECTION=ON

# WDT will force tests to continue for certain types of TF-M
# tests. This can be inconvenient when debugging. But the WDT can
# also be a necessary part of the test execution.
# -DWATCHDOG_AVAILABLE=0
)
```

## prj.conf
```kconfig
CONFIG_BUILD_WITH_TFM=y
CONFIG_TFM_PROFILE_TYPE_NOT_SET=y

CONFIG_PRINTK=y
CONFIG_SHELL=y
CONFIG_LOG=y
CONFIG_INIT_STACKS=y
CONFIG_THREAD_STACK_INFO=y
CONFIG_KERNEL_SHELL=y
CONFIG_THREAD_MONITOR=y
CONFIG_BOOT_BANNER=n
CONFIG_THREAD_NAME=y
CONFIG_DEVICE_SHELL=y
CONFIG_POSIX_CLOCK=y
CONFIG_DATE_SHELL=y
CONFIG_HEAP_MEM_POOL_SIZE=24576
#CONFIG_THREAD_ANALYZER=y
#CONFIG_THREAD_ANALYZER_USE_PRINTK=y
#CONFIG_THREAD_ANALYZER_AUTO=y
#CONFIG_THREAD_ANALYZER_AUTO_INTERVAL=10
CONFIG_SHELL_STACK_SIZE=24576
CONFIG_FW_INFO=y
CONFIG_SHELL_CMD_BUFF_SIZE= 376
CONFIG_NEWLIB_LIBC=y
CONFIG_NEWLIB_LIBC_NANO=n
CONFIG_NEWLIB_LIBC_FLOAT_PRINTF=y
CONFIG_CJSON_LIB=y
CONFIG_NRF_MODEM_LIB=n
CONFIG_NORDIC_SECURITY_BACKEND=y
CONFIG_MAIN_STACK_SIZE=17408

# For building without enable debug option
#CONFIG_PM_PARTITION_SIZE_TFM=0x50000
# For building with enable debug option
CONFIG_PM_PARTITION_SIZE_TFM=0x60000

# Enable USB CDC ACM
#CONFIG_USB=y
#CONFIG_USB_DEVICE_STACK=y
#CONFIG_USB_CDC_ACM=y
#CONFIG_USB_CDC_ACM_LOG_LEVEL_ERR=y
#CONFIG_USB_DEVICE_LOG_LEVEL_ERR=y
#CONFIG_USB_UART_CONSOLE=y
#CONFIG_USB_CDC_ACM_DEVICE_NAME="CDC_ACM"
#CONFIG_UART_CONSOLE_ON_DEV_NAME="CDC_ACM_0"
#CONFIG_UART_LINE_CTRL=y
#CONFIG_UART_SHELL_ON_DEV_NAME="CDC_ACM_0"
#CONFIG_SHELL_BACKEND_SERIAL_INIT_PRIORITY=51
#CONFIG_SHELL_BACKEND_SERIAL_RX_RING_BUFFER_SIZE=512
#CONFIG_SHELL_BACKEND_SERIAL_TX_RING_BUFFER_SIZE=512

# This option enables the UART logging backend.
CONFIG_LOG_BACKEND_UART=y
CONFIG_LOG_DEFAULT_LEVEL=4
#CONFIG_LOG_PRINTK=y
CONFIG_DEBUG_OPTIMIZATIONS=y
CONFIG_DEBUG_THREAD_INFO=y
CONFIG_LOG_MODE_IMMEDIATE=y
CONFIG_ASSERT=y
CONFIG_NO_OPTIMIZATIONS=y
CONFIG_THREAD_NAME=y
CONFIG_USE_SEGGER_RTT=y
CONFIG_LOG_BACKEND_RTT=y
CONFIG_LOG_BACKEND_SHOW_COLOR=y
#?CONFIG_TFM_SPM_LOG_LEVEL_INFO=y

CONFIG_RESET_ON_FATAL_ERROR=n

# Configuration added to watch more information about Fatal Errors
CONFIG_TFM_PARTITION_LOG_LEVEL_DEBUG=y
CONFIG_TFM_SPM_LOG_LEVEL_DEBUG=y

# Dump exception info. Must be combined with enabling log output.
CONFIG_TFM_EXCEPTION_INFO_DUMP=y

# Don't use the minimal TF-M configuration as that doesn't support logging
CONFIG_TFM_PROFILE_TYPE_NOT_SET=y
```

## src/main.c
```c
/*
 * Copyright (c) 2015 Intel Corporation
 *
 * SPDX-License-Identifier: Apache-2.0
 */
#include <zephyr/sys/printk.h>
#include <zephyr/shell/shell.h>
#include <version.h>
#include <zephyr/logging/log.h>
#include <stdlib.h>
#include <zephyr/kernel.h>
#include <stdio.h>
#include <secure_services.h>
#include <pm_config.h>
#include <fw_info.h>
#include <zephyr/drivers/uart.h>
#include <cJSON.h>
#include <string.h>
#ifdef CONFIG_USB
#include <usb/usb_device.h>
#endif

#include <blst.h>
#include <common.h>
#include <bls_hsm_ns.h>

char buffer[2048] = "";

#define CONFIG_SPM_SERVICE_RNG

LOG_MODULE_REGISTER(app);

static int cmd_keygen(const struct shell *shell, size_t argc, char **argv)
{
    if(argc == 1){
        keygen("", buffer);
    }else{
        keygen(argv[1], buffer);
    }
    printf("%s", buffer);
    memset(buffer, 0, 2048);
    return 0;
}

static int cmd_signature_message(const struct shell *shell, size_t argc, char **argv, char* buff)
{
    if(signature(argv[1], argv[2], buffer) == 0){
        printf("Signature: \n");
        printf("%s%s\n", "0x", buffer);
    }else{
        printf("%s", buffer);
    }
    memset(buffer, 0, 2048);
	return 0;
}

static int cmd_signature_verification(const struct shell *shell, size_t argc, char **argv, char* buff)
{
    verify(argv[1], argv[2], argv[3], buffer);
    printf("%s", buffer);
    memset(buffer, 0, 2048);
	return 0;
}

static int cmd_get_keys(const struct shell *shell, size_t argc, char **argv, char* buff)
{
    print_keys_Json(buffer);
    printf("%s", buffer);
    memset(buffer, 0, 2048);
	return 0;
}

static int cmd_reset(const struct shell *shell, size_t argc, char **argv, char* buff){
    resetc(buffer);
    printf("%s", buffer);
    memset(buffer, 0, 2048);
    return 0;
}

static int cmd_prompt(const struct shell *shell, size_t argc, char **argv){
    ARG_UNUSED(argc);

    if(strcmp(argv[1], "on") == 0){
        shell_prompt_change(shell, "uart:~$ ");
    }else if(strcmp(argv[1], "off") == 0){
        shell_prompt_change(shell, "");
    }else{
        printf("Usage: prompt on/off\n");
    }
    return 0;
}

static int cmd_import(const struct shell *shell, size_t argc, char **argv){
    import(argv[1], buffer);
    printf("%s", buffer);
    memset(buffer, 0, 2048);
    return 0;
}

SHELL_CMD_ARG_REGISTER(keygen, NULL, "Generates secret key and public key", cmd_keygen, 1, 1);

SHELL_CMD_ARG_REGISTER(signature, NULL, "Signs a message with a specific public key", cmd_signature_message, 3, 0);

SHELL_CMD_ARG_REGISTER(verify, NULL, "Verifies the signature", cmd_signature_verification, 4, 0);

SHELL_CMD_ARG_REGISTER(getkeys, NULL, "Returns the identifiers of the keys available to the signer", cmd_get_keys, 1, 0);

SHELL_CMD_ARG_REGISTER(reset, NULL, "Deletes all generated keys", cmd_reset, 1, 0);

SHELL_CMD_ARG_REGISTER(prompt, NULL, "Toggle prompt", cmd_prompt, 2, 0);

SHELL_CMD_ARG_REGISTER(import, NULL, "Import secret key", cmd_import, 2, 0);

void main(void)
{
    tfm_init();
#if defined(CONFIG_USB_UART_CONSOLE)
	const struct device *dev;
	uint32_t dtr = 0;

	dev = device_get_binding(CONFIG_UART_SHELL_ON_DEV_NAME);
	if (dev == NULL || usb_enable(NULL)) {
		return;
	}

	while (!dtr) {
		uart_line_ctrl_get(dev, UART_LINE_CTRL_DTR, &dtr);
		k_sleep(K_MSEC(100));
	}
#endif
}
```

## include/bls_hsm.c
```c
#include "bls_hsm.h"
#include "common.h"
#include <stdlib.h>
#include <string.h>

/*
Converts input 'pk' to binary 'out'
*/
void pk_serialize(byte* out, blst_p1 pk){
        blst_p1_compress(out, &pk);
}

/*
Converts input 'sig' to binary 'out2'
*/
void sig_serialize(byte* out2, blst_p2 sig){
        blst_p2_compress(out2, &sig);
}

/*
Get 'hash' from binary string 'msg_bin' with length 'len'
*/
void get_point_from_msg(blst_p2* hash, uint8_t* msg_bin, int len){
        char dst[] = "BLS_SIG_BLS12381G2_XMD:SHA-256_SSWU_RO_POP_"; //IETF BLS Signature V4
        //Obtain the point from a message
        blst_hash_to_g2(hash, msg_bin, len, dst, sizeof(dst)-1, NULL, 0);
}

/*
Derive 'pk' from hexadecimal string 'pk_hex'. Errors are dumped to 'buff'
On error returns 1
*/
int pk_parse(char* pk_hex, blst_p1_affine* pk, char* buff){
        byte pk_bin[48];
        int offset = parse_hex(pk_hex, 96);
        int error = 0;

        if(offset == BADLEN){
            strcat(buff, "Incorrect public key length. It must be 96 characters long.\n");
            error = 1;
        }else if(offset == BADFORMAT){
                strcat(buff, "Public key contains incorrect characters.\n");
                error = 1;
        }else{
            if(hex2bin(pk_hex + offset, 96, pk_bin, 48) == 0) {
                strcat(buff, "Failed converting public key to binary array\n");
                error = 1;
            }else{
                blst_p1_uncompress(pk, pk_bin);
            }
        }
        
        return error;
}

/*
Converts hexadecimal string 'msg' with length 'len' to binary string 'msg_bin'. Errors are dumped to 'buff'.
On error returns 1
*/
int msg_parse(char* msg, uint8_t* msg_bin, int len, char* buff){

        int offset = parse_hex(msg, len);
        int error = 0;
        if(offset == BADFORMAT){
            strcat(buff, "Message contains incorrect characters.\n");
            error = 1;
        }else if(offset == BADLEN){
            strcat(buff, "Message contains incorrect characters.\n");
            error = 1;
        }else{
            if(hex2bin(msg + offset, len, msg_bin, len/2 + len%2) == 0) {
                strcat(buff, "Incorrect message length.\n");
                error = 1;
            }
        }

        return error;
}

/*
Derive 'sig' from hexadecimal string 'sig_hex'. Errors are dumped to 'buff'
On error returns 1
*/
int sig_parse(char* sig_hex, blst_p2_affine* sig, char* buff){
        byte sig_bin[96];
        int offset = parse_hex(sig_hex, 192);
        int error = 0;

        if(offset == BADLEN){
            strcat(buff, "Incorrect signature length. It must be 192 characters long.\n");
            error = 1;
        }else if(offset == BADFORMAT){
            strcat(buff, "Signature contains incorrect characters.\n");
            error = 1;
        }else{
            if(hex2bin(sig_hex + offset, 192, sig_bin, 96) == 0) {
                strcat(buff, "Failed converting signature to binary array\n");
                error = 1;
            }else{
                blst_p2_uncompress(sig, sig_bin);
            }
        }
        return error;
}

/*
Generates random key. Response is dumped to 'buff'
*/
void keygen(int argc, char** argv, char* buff){
    int keystore_size = get_keystore_size();

    if(keystore_size < 10){
        // key_info is an optional parameter.  This parameter MAY be used to derive
        // multiple independent keys from the same IKM.  By default, key_info is the empty string.
        char info[] = {
            0x00, 0x00, 0x00, 0x00, 0x00, 0x00, 0x00, 0x00,
            0x00, 0x00, 0x00, 0x00, 0x00, 0x00, 0x00, 0x00,
            0x00, 0x00, 0x00, 0x00, 0x00, 0x00, 0x00, 0x00,
            0x00, 0x00, 0x00, 0x00, 0x00, 0x00, 0x00, 0x00};
    
        if(argc == 2){
                if(strlen(argv[1]) <= strlen(info)){
                        strcpy(info, argv[1]);
                }else{
                        strncpy(info, argv[1], sizeof(info));
                }
        }

        ikm_sk(info);
    
        //The secret key allow us to generate the associated public key
        blst_p1 pk;
        byte out[48];
        char public_key_hex[96];
        sk_to_pk(&pk);
        pk_serialize(out, pk);
        strcat(buff, "Public key: \n");
        if(bin2hex(out, sizeof(out), public_key_hex, sizeof(public_key_hex)) == 0) {
            strcat(buff, "Failed converting binary key to string\n");
        }
    
        store_pk(public_key_hex);
        print_pk(public_key_hex, buff);
    }else{
        strcat(buff, "Can't generate more keys. Limit reached.\n");
    }
}

/*
Gets hexadecimal string 'signature' from given public key 'pk' and message 'msg' 
*/
void get_signature(char* pk, char* msg, char* signature){
    int offset = parse_hex(pk, 96);
    pk_in_keystore(pk, offset);
    int len = msg_len(msg);
    uint8_t msg_bin[len/2 + len%2];
    offset = parse_hex(msg, len);
    hex2bin(msg + offset, len, msg_bin, len/2 + len%2);
    blst_p2 hash;
    get_point_from_msg(&hash, msg_bin, len/2 + len%2);

    blst_p2 sig;
    byte sig_bin[96];
    char sig_hex[192];

    sign_pk(&sig, &hash);
    sig_serialize(sig_bin, sig);
    bin2hex(sig_bin, sizeof(sig_bin), signature, 192);
}

/*
Signs message with given public key. Public key must be stored. Response is dumped to 'buff'
*/
int signature(char* pk, char* msg, char* buff){
    //Message examples
    //char * msg_hex = "5656565656565656565656565656565656565656565656565656565656565656";
    //char * msg_hex = "b6bb8f3765f93f4f1e7c7348479289c9261399a3c6906685e320071a1a13955c";

    int offset = parse_hex(pk, 96);

    if(offset >= 0){
        if(pk_in_keystore(pk, offset) != -1){
            int len = msg_len(msg);
            uint8_t msg_bin[len/2 + len%2];
            if(msg_parse(msg, msg_bin, len, buff) != 1){
                blst_p2 hash;
                get_point_from_msg(&hash, msg_bin, len/2 + len%2);

                blst_p2 sig;
                byte sig_bin[96];
                char sig_hex[192];

                sign_pk(&sig, &hash);
                sig_serialize(sig_bin, sig);
                if(bin2hex(sig_bin, sizeof(sig_bin), sig_hex, sizeof(sig_hex)) == 0) {
                    strcat(buff, "Failed converting binary signature to string\n");
                }
                strcpy(buff, sig_hex);
            }
        }else{
            strcat(buff, "Public key isn't stored\n");
            return PKNOTFOUND;
        }
    }else if(offset == BADLEN){
        strcat(buff, "Incorrect public key length. It must be 96 characters long\n");
        return BADLEN;
    }else{
        strcat(buff, "Public key contains incorrect characters.\n");
        return BADFORMAT;
    }
    return 0;
}

/*
Verifies signature of given message and public key
*/
void verify(char** argv, char* buff){
    char dst[] = "BLS_SIG_BLS12381G2_XMD:SHA-256_SSWU_RO_POP_"; //IETF BLS Signature V4

    blst_p1_affine pk;
    blst_p2_affine sig;
    int len = msg_len(argv[2]);
    uint8_t msg_bin[len/2 + len%2];
    if((pk_parse(argv[1], &pk, buff) || msg_parse(argv[2], msg_bin, len, buff) || sig_parse(argv[3], &sig, buff)) != 1){
        if(blst_core_verify_pk_in_g1(&pk, &sig, 1, msg_bin, len/2 + len%2, dst, sizeof(dst)-1, NULL, 0) != BLST_SUCCESS){
            strcat(buff, "Error\n");
        }
        else {
            strcat(buff, "Success\n");
        }
    }
}

/*
Get array of stored public keys in buffer 'buff'
*/
void dump_keys(char* buff){
    int keystore_size = get_keystore_size();
    char public_keys_hex_store[keystore_size][96];
    getkeys(public_keys_hex_store);
    if(keystore_size != 0){
        strcat(buff, "{\"keys\":[\"");
        for(int i = 0; i < keystore_size; i++){
            for(int j = 0; j < 96; j++){
                char str[2] = {public_keys_hex_store[i][j], '\0'};
                strcat(buff, str);
            }
            if (i + 1 < keystore_size){
                strcat(buff, "\",\n\"");
            } else {
                strcat(buff, "\"]}\n");
            }                        
        }
    }else{
        strcat(buff, "There are no keys stored\n");
    }
}

/*
Delete all stored public and secret keys. Response is dumped to 'buff'
*/
void resetc(char* buff){
    reset();
    strcat(buff, "Keys deleted\n");
}

/*
Import given secret key. Derived public key and errors are dumped to 'buff'
*/
void import(char* sk, char* buff){
    if(get_keystore_size() < 10){
        int offset = parse_hex(sk, 64);

        if(offset >= 0){
            byte sk_bin[32];
            if(hex2bin(sk + offset, 64, sk_bin, 32) == 0){
                strcat(buff, "Failed converting hex to bin\n");
            }else{
                blst_scalar sk_imp;
                blst_scalar_from_bendian(&sk_imp, sk_bin);
                if(import_sk(&sk_imp) == 0){

                    blst_p1 pk;
                    sk_to_pk(&pk);
                    byte pk_bin[48];
                    pk_serialize(pk_bin, pk);
                    char pk_hex[96];
                    if(bin2hex(pk_bin, 48, pk_hex, 96) == 0){
                        strcat(buff, "Failed converting bin to hex\n");
                    }else{
                        store_pk(pk_hex);
                        print_pk(pk_hex, buff);
                    }
                }else{
                        strcat(buff, "Key already imported\n");
                }
            }
        }else if(offset == BADFORMAT){
            strcat(buff, "Incorrect characters\n");
        }else{
            strcat(buff, "Incorrect secret key length\n");
        }
    }else{
            strcat(buff, "Limit reached\n");
    }
}
```

## include/bls_hsm.h
```c
#ifndef bls_hsm_h
#define bls_hsm_h
#include "blst.h"
#define PKNOTFOUND 1

int pk_in_keystore(char * public_key_hex, int offset);
void ikm_sk(char* info);
void sk_to_pk(blst_p1* pk);
void sign_pk(blst_p2* sig, blst_p2* hash);
void reset();
void store_pk(char* public_key_hex);
int get_keystore_size();
void getkeys(char** public_keys_hex_store_ns);
int import_sk(blst_scalar* sk_imp);

void pk_serialize(byte* out, blst_p1 pk);
void sig_serialize(byte* out2, blst_p2 sig);
void get_point_from_msg(blst_p2* hash, uint8_t* msg_bin, int len);
int pk_parse(char* pk_hex, blst_p1_affine* pk, char* buff);
int msg_parse(char* msg, uint8_t* msg_bin, int len, char* buff);
int sig_parse(char* sig_hex, blst_p2_affine* sig, char* buff);
void keygen(int argc, char** argv, char* buff);
void get_signature(char* pk, char* msg, char* signature);
int signature(char* pk, char* msg, char* buff);
void verify(char** argv, char* buff);
void dump_keys(char* buff);
void resetc(char* buff);
void import(char* sk, char* buff);
#endif
```

## include/common.h
```c
#ifndef COMMON_H
#define COMMON_H

#include <stdlib.h>
#include <string.h>
#define BADLEN -1
#define BADFORMAT -2

#ifdef EMU

int char2hex(char c, uint8_t *x);

int hex2char(uint8_t x, char *c);

size_t bin2hex(const uint8_t *buf, size_t buflen, char *hex, size_t hexlen);

size_t hex2bin(const char *hex, size_t hexlen, uint8_t *buf, size_t buflen);

#endif

int parse_hex(char* str, int len);

int char_chk(char* aux, int len);

void print_pk(char* public_key_hex, char* buff);

void print_sig(char* sig_hex, char* buff);

int msg_len(char* msg);

#endif
```

## include/commonBoard.h
```c
#ifndef COMMONBOARD_H
#define COMMONBOARD_H

#include "blst.h"
#include <stdlib.h>
#include <errno.h>

/*
    All functions must return -1 on error and 0 on success, also functions must add the error code to the variable errno.
*/

/*
********************************************************ERRORS*****************************************************************
*/
#define noKeys 0
#define noKey 1
#define incorrectPubKeyLength 2
#define failBinaryToStr 3
#define failHexToBin 4
#define failBinToHex 5
#define keyAlreadyIn 6
#define incorrectCharacters 7
#define incorrectPrivKeyLength 8
#define tooManyKeys 9
#define keystoreTooBig 10
#define passwordTooBig 11
#define notSamePasswordsKeystores 12

void print_error(){
    switch(errno){
        case noKeys:
            printf("Error %d: No keys stored.\n", noKeys);
            break;
        case noKey:
            printf("Error %d: Keys is not stored.\n", noKey);
            break;
        case incorrectPubKeyLength:
            printf("Error %d: incorrect Public Key length.\n", incorrectPubKeyLength);
            break;
        case failBinaryToStr:
            printf("Error %d: fail converting binary to string.\n", failBinaryToStr);
            break;
        case failHexToBin:
            printf("Error %d: fail converting hex to binary.\n", failHexToBin);
            break;
        case failBinToHex:
            printf("Error %d: fail converting binary to hex.\n", failBinToHex);
            break;
        case keyAlreadyIn:
            printf("Error %d: key already imported.\n", keyAlreadyIn);
            break;
        case incorrectCharacters:
            printf("Error %d: Private Key with incorrect characters.\n", incorrectCharacters);
            break;
        case incorrectPrivKeyLength:
            printf("Error %d: incorrect Private Key length.\n", incorrectPrivKeyLength);
            break;
        case tooManyKeys:
            printf("Error %d: too many Keys already imported.\n", tooManyKeys);
            break;
        case keystoreTooBig:
            printf("Error %d: keystore too big.\n", keystoreTooBig);
            break;
        case passwordTooBig:
            printf("Error %d: password for keystore too big.\n", passwordTooBig);
            break;
        case notSamePasswordsKeystores:
            printf("Error %d: there are not the same number of passwords than keystores.\n", notSamePasswordsKeystores);
            break;
        deafult:
            printf("Error unknown.\n");
    }
}

/*
*******************************************************************************************************************************
*/

int char2hex(char c, uint8_t *x)
{
	if (c >= '0' && c <= '9') {
		*x = c - '0';
	} else if (c >= 'a' && c <= 'f') {
		*x = c - 'a' + 10;
	} else if (c >= 'A' && c <= 'F') {
		*x = c - 'A' + 10;
	} else {
		return -22;
	}

	return 0;
}

int hex2char(uint8_t x, char *c)
{
	if (x <= 9) {
		*c = x + '0';
	} else  if (x <= 15) {
		*c = x - 10 + 'a';
	} else {
		return -22;
	}

	return 0;
}

size_t bin2hex(const uint8_t *buf, size_t buflen, char *hex, size_t hexlen)
{
	if ((hexlen + 1) < buflen * 2) {
		return 0;
	}

	for (size_t i = 0; i < buflen; i++) {
		if (hex2char(buf[i] >> 4, &hex[2 * i]) < 0) {
			return 0;
		}
		if (hex2char(buf[i] & 0xf, &hex[2 * i + 1]) < 0) {
			return 0;
		}
	}

	hex[2 * buflen] = '\0';
	return 2 * buflen;
}

size_t hex2bin(const char *hex, size_t hexlen, uint8_t *buf, size_t buflen)
{
	uint8_t dec;

	if (buflen < hexlen / 2 + hexlen % 2) {
		return 0;
	}

	/* if hexlen is uneven, insert leading zero nibble */
	if (hexlen % 2) {
		if (char2hex(hex[0], &dec) < 0) {
			return 0;
		}
		buf[0] = dec;
		hex++;
		buf++;
	}

	/* regular hex conversion */
	for (size_t i = 0; i < hexlen / 2; i++) {
		if (char2hex(hex[2 * i], &dec) < 0) {
			return 0;
		}
		buf[i] = dec << 4;

		if (char2hex(hex[2 * i + 1], &dec) < 0) {
			return 0;
		}
		buf[i] += dec;
	}

	return hexlen / 2 + hexlen % 2;
}

int pk_in_keystore(char * public_key_hex, int offset);
void ikm_sk(char* info);
void sk_to_pk(blst_p1* pk);
void sign_pk(blst_p2* sig, blst_p2* hash);
void reset();
void store_pk(char* public_key_hex);
int get_keystore_size();
void getkeys(char* public_keys_hex_store_ns);
int import_sk(blst_scalar* sk_imp);

void pk_serialize(byte* out, blst_p1 pk){
        blst_p1_compress(out, &pk);
}

void sig_serialize(byte* out2, blst_p2 sig){
        blst_p2_compress(out2, &sig);
}

void get_point_from_msg(blst_p2* hash, uint8_t* msg_bin, int len){
        char dst[] = "BLS_SIG_BLS12381G2_XMD:SHA-256_SSWU_RO_POP_"; //IETF BLS Signature V4
        //Obtain the point from a message
        blst_hash_to_g2(hash, msg_bin, len, dst, sizeof(dst)-1, NULL, 0);
}

int parse(char* str, int len){
        int offset;

        int strl = strlen(str);

        if((str[0] == '0') && (str[1] == 'x')){
            if(strl == len+2){
                 offset = 2;
            }else{
                offset = -1;
            }
        }else{
            if(strl == len){
                 offset = 0;
            }else{
                offset = -1;
            }
        }

        return offset;
}

int char_chk(char* aux, int len){
        int error = 0;

        for(int i = 0; (i < len) && (error == 0); i++){
            if(!((aux[i] >= '0' && aux[i] <= '9') || (aux[i] >= 'a' && aux[i] <= 'f') || (aux[i] >= 'A' && aux[i] <= 'F'))){
                error = 1;
            }
        }

        return error;
}

void print_pk(char* public_key_hex, char* buff){
        strcat(buff, "0x");
		for(int i = 0; i < 96; i++) {
			char str[2] = {public_key_hex[i], '\0'};
        	strcat(buff, str);
		}
}

void print_sig(char* sig_hex, char* buff){    
        strcat(buff, "0x");
        for(int i = 0; i < 192; i++) {
          char str[2] = {sig_hex[i], '\0'};
          strcat(buff, str);
        }
}

int pk_parse(char* pk_hex, blst_p1_affine* pk, char* buff){
        byte pk_bin[48];
        int offset = parse(pk_hex, 96);
        int error = 0;

        if(offset == -1){
            strcat(buff, "Incorrect public key length. It must be 96 characters long.\n");
            error = 1;
        }else{
            if(char_chk(pk_hex + offset, 96)){
                strcat(buff, "Public key contains incorrect characters.\n");
                error = 1;
            }else{
                if(hex2bin(pk_hex + offset, 96, pk_bin, 48) == 0) {
                    strcat(buff, "Failed converting public key to binary array\n");
                    error = 1;
                }else{
                    blst_p1_uncompress(pk, pk_bin);
                }
            }
        }
        
        return error;
}

int msg_parse(char* msg, uint8_t* msg_bin, int len, char* buff){

        int offset;
        if(msg[0] == '0' && msg[1] == 'x'){
            offset = 2;
        }else{
            offset = 0;
        }
        int error = 0;

        if(char_chk(msg + offset, len)){
            strcat(buff, "Message contains incorrect characters.\n");
            error = 1;
        }else{
            if(hex2bin(msg + offset, len, msg_bin, len/2 + len%2) == 0) {
                strcat(buff, "Failed converting message to binary array\n");
                error = 1;
            }
        }


        return error;
}

int sig_parse(char* sig_hex, blst_p2_affine* sig, char* buff){
        byte sig_bin[96];
        int offset = parse(sig_hex, 192);
        int error = 0;

        if(offset == -1){
            strcat(buff, "Incorrect signature length. It must be 192 characters long.\n");
            error = 1;
        }else{
            if(char_chk(sig_hex + offset, 192)){
                strcat(buff, "Signature contains incorrect characters.\n");
                error = 1;
            }else{
                if(hex2bin(sig_hex + offset, 192, sig_bin, 96) == 0) {
                    strcat(buff, "Failed converting signature to binary array\n");
                    error = 1;
                }else{
                    blst_p2_uncompress(sig, sig_bin);
                }
            }
        }
        return error;
}

int msg_len(char* msg){
    int len;
    if(msg[0] == '0' && msg[1] == 'x'){
        len = strlen(msg + 2);
    }else{
        len = strlen(msg);
    }
    return len;
}

void keygen(int argc, char** argv, char* buff){
    int keystore_size = get_keystore_size();

    if(keystore_size < 10){
        // key_info is an optional parameter.  This parameter MAY be used to derive
        // multiple independent keys from the same IKM.  By default, key_info is the empty string.
        char info[] = {
            0x00, 0x00, 0x00, 0x00, 0x00, 0x00, 0x00, 0x00,
            0x00, 0x00, 0x00, 0x00, 0x00, 0x00, 0x00, 0x00,
            0x00, 0x00, 0x00, 0x00, 0x00, 0x00, 0x00, 0x00,
            0x00, 0x00, 0x00, 0x00, 0x00, 0x00, 0x00, 0x00};
    
        if(argc == 2){
                if(strlen(argv[1]) <= strlen(info)){
                        strcpy(info, argv[1]);
                }else{
                        strncpy(info, argv[1], sizeof(info));
                }
        }

        ikm_sk(info);
    
        //The secret key allow us to generate the associated public key
        blst_p1 pk;
        byte out[48];
        char public_key_hex[96];
        sk_to_pk(&pk);
        pk_serialize(out, pk);
        strcat(buff, "Public key: \n");
        if(bin2hex(out, sizeof(out), public_key_hex, sizeof(public_key_hex)) == 0) {
            strcat(buff, "Failed converting binary key to string\n");
        }
    
        store_pk(public_key_hex);
        print_pk(public_key_hex, buff);
    }else{
        strcat(buff, "Can't generate more keys. Limit reached.\n");
    }
}

int signature(char* pubKey, char* signingRoot, char* responseSigned){
    //Message examples
    //char * msg_hex = "5656565656565656565656565656565656565656565656565656565656565656";
    //char * msg_hex = "b6bb8f3765f93f4f1e7c7348479289c9261399a3c6906685e320071a1a13955c";

    int offset = parse(pubKey, 96);

    responseSigned[0] = '\0';

    if(offset != -1){
        if(pk_in_keystore(pubKey, offset) != -1){
            int len = msg_len(signingRoot);
            uint8_t msg_bin[len/2 + len%2];
            if(msg_parse(signingRoot, msg_bin, len, responseSigned) != 1){
                blst_p2 hash;
                get_point_from_msg(&hash, msg_bin, len/2 + len%2);

                blst_p2 sig;
                byte sig_bin[96];
                char sig_hex[192];

                sign_pk(&sig, &hash);
                sig_serialize(sig_bin, sig);

                if(bin2hex(sig_bin, sizeof(sig_bin), sig_hex, sizeof(sig_hex)) == 0) {
                    errno = failBinaryToStr;
                    return -1;
                }
                print_sig(sig_hex, responseSigned);
            }
        }else{
            errno = noKey;
            return -1;
        }
    }else{
        errno = incorrectPubKeyLength;
        return -1;
    }

    return 0;
}

void verify(int argc, char** argv, char* buff){
    char dst[] = "BLS_SIG_BLS12381G2_XMD:SHA-256_SSWU_RO_POP_"; //IETF BLS Signature V4

    blst_p1_affine pk;
    blst_p2_affine sig;
    int len = msg_len(argv[2]);
    uint8_t msg_bin[len/2 + len%2];
    if((pk_parse(argv[1], &pk, buff) || msg_parse(argv[2], msg_bin, len, buff) || sig_parse(argv[3], &sig, buff)) != 1){
        if(blst_core_verify_pk_in_g1(&pk, &sig, 1, msg_bin, len/2 + len%2, dst, sizeof(dst)-1, NULL, 0) != BLST_SUCCESS){
            strcat(buff, "Error\n");
        }
        else {
            strcat(buff, "Success\n");
        }
    }
}

int get_keys(char** keys, int* nKeys){
    int keystore_size = get_keystore_size();
    *nKeys = keystore_size;

    char public_keys_hex_store[96*keystore_size];
    getkeys(public_keys_hex_store);
    if(keystore_size != 0){
        for(int j = 0; j < keystore_size; ++j){
            keys[j][0] = '0';
            keys[j][1] = 'x';

            for(int i = 0; i < 96; ++i){
                keys[j][i + 2] = public_keys_hex_store[(96*j) + i];
            }

            keys[j][98] = '\0';
        }
    }else{
        errno = noKeys;
        return -1;
    }

    return 0;
}

void resetc(int argc, char** argv, char* buff){
    reset();
    strcat(buff, "Keys deleted\n");
}

int import(char* privateKey){
    if(get_keystore_size() < 10){
        int offset = parse(privateKey, 64);

        if(offset != -1){
            if(!char_chk(privateKey + offset, 64)){
                byte sk_bin[32];
                if(hex2bin(privateKey + offset, 64, sk_bin, 32) == 0){
                    errno = failHexToBin;
                    return -1;
                }else{
                    blst_scalar sk_imp;
                    blst_scalar_from_bendian(&sk_imp, sk_bin);
                    if(import_sk(&sk_imp) == 0){

                        blst_p1 pk;
                        sk_to_pk(&pk);
                        byte pk_bin[48];
                        pk_serialize(pk_bin, pk);
                        char pk_hex[96];
                        if(bin2hex(pk_bin, 48, pk_hex, 96) == 0){
                            errno = failBinToHex;
                            return -1;
                        }else{
                            store_pk(pk_hex);
                        }
                    }else{
                        errno = keyAlreadyIn;
                        return -1;
                    }
                }
            }else{
                errno = incorrectCharacters;
                return -1;
            }
        }else{
            errno = incorrectPrivKeyLength;
            return -1;
        }
    }else{
        errno = tooManyKeys;
        return -1;
    }
}

int import_from_keystore(char** keystores, char** passwords, int nKeys){
    
    
    return 0;
}

#endif
```

## include/httpRemote.h
```c
/*
    A library to handle http requests to the remote signer

    IMPORTANT comment about MAXHeaders and MAXKeys(maximum keystore)

    Ask about maximum size of an ethereum signature
*/

#ifndef httpRemote_h
#define httpRemote_h

#include "./picohttpparser.h"
#include <cJSON.h>
#include <unistd.h>
#include <string.h>
#include <stdlib.h>
#include <stdio.h>
#include "common.h"
#include "bls_hsm.h"

#define signatureOffset 12//due to  Signature: \n

#define MAXSizeEthereumSignature 192
#define MAXBUF 32768
#define MAXHeaders 100
#define MAXKeys 10 //Maximum numbers of keys to store
#define keySize 96

#define sign 0
#define upcheck 1
#define getKeys 2

char upcheckStr[] = "/upcheck";
char getKeysStr[] = "/api/v1/eth2/publicKeys";
char signRequestStr[] = "/api/v1/eth2/sign/0x";
char contentLengthStr[] = "content-length";

/*
**********************************************************RESPONSES****************************************************************
*/
char upcheckResponse[] = "HTTP/1.1 200 OK\r\n"
   "content-type: text/p"
   "lain; charset=utf-8"
   "\r\n"
   "content-length: 0\r\n\r\n";

/*
We got to add later the size of the json in text, 2 \n and the json with the publick Keys
json format: ["0xkey", "0xkey", ....]
keys are in hex
*/
char getKeysResponse[] = "HTTP/1.1 200 OK\r\n"
   "Content-Type: application/json"
   "\r\n"
   "Content-Length: ";

/*
We got to add later the size of the signature, 2 \n and the signature
signature format 0xsignature
signature is in hex
*/
char signResponse[] = "HTTP/1.1 200 OK\r\n"
   "Content-Type: application/json"
   "\r\n"
   "Content-Length: ";

char* badRequest = "HTTP/1.1 400 Bad request format\r\n"
"Content-Type: application/json\r\n"
"Content-Length: 0\r\n\r\n";

char* pknf = "HTTP/1.1 404 Public key not found\r\n"
"Content-Type: application/json\r\n"
"Content-Length: 0\r\n\r\n";

/*
************************************************************************************************************************************
*/

struct boardRequest{
    int method; //Board
    char* json;
    char* keyToSign;//Size is always of keySize bytes
    char publicKeys[MAXKeys][keySize];//In hex
    int nKeys;//number of keys
    int jsonLen;//In fact we won't need this field because there will be a \0 at the end of the json, but just in case 
};

struct httpRequest{
    char* method;
    char* path;
    char* body;
    size_t requestLen;
    size_t methodLen;
    size_t pathLen;
    size_t bodyLen;
    int minorVersion;
    struct phr_header headers[MAXHeaders];//We can only process this number of headers
    size_t numHeaders;   
};

/*
    On success returns 0
    On empty keystore returns -1
*/
int copyKeys(struct boardRequest* request){
    int ksize = get_keystore_size();
    if(ksize == 0){
        request->nKeys = 0;
        return -1;
    }else{
        char buffer[ksize][96];
        getkeys(buffer);
        request->nKeys = 0;
        for(int i = 0; i < ksize; i++){
            ++(request->nKeys);
            strncpy(request->publicKeys[i], buffer[i], 96);
        }
    }

    return 0;
}

void getBody(char* buffer, size_t bufferSize, struct httpRequest* request){
    int bodyLengthPosition;//Where is content-length in request->headers
    int contentLengthStrSize = strlen(contentLengthStr);

    //14 is the size of content-length
    for(bodyLengthPosition = 0; 
    (bodyLengthPosition < (int) request->numHeaders) && (request->headers[bodyLengthPosition].name != NULL) &&
    !((request->headers[bodyLengthPosition].name_len == contentLengthStrSize) 
    && (strncmp(contentLengthStr, request->headers[bodyLengthPosition].name, contentLengthStrSize))); 
    ++bodyLengthPosition){}

    if(bodyLengthPosition < request->numHeaders){
        char bodyLenChar[(int) request->headers[bodyLengthPosition].value_len + 1];
        strncpy(bodyLenChar, request->headers[bodyLengthPosition].value, request->headers[bodyLengthPosition].value_len);
        bodyLenChar[(int) request->headers[bodyLengthPosition].value_len] = '\0';

        request->bodyLen = (size_t) atoi(bodyLenChar);

        if((int) request->bodyLen > 0){
            request->body = buffer + (int) bufferSize - (int) request->bodyLen;
            //printf("%s", request->body);
        }else{
            request->body = NULL;
        }
    }
}

/*
    On succes returns 0
    On error returns -1
*/
int checkKey(struct boardRequest* request){
    if(copyKeys(request) == -1){
        return -1;
    }else{
        for(int i = 0; i < request->nKeys; ++i){
            if(strncmp(request->keyToSign, request->publicKeys[i], keySize) == 0){ 
                return 0;
            }
        }
    }

    return -1;
}

/*   
    On succes returns 0
    On error returns -1
    We are only going to support GET and POST requests, so if we get another type of request we are going to handle it like an error.
*/
int parseRequest(char* buffer, size_t bufferSize, struct boardRequest* reply){//boardRequest out, buffer in
    buffer[bufferSize] = '\0';
    struct httpRequest request;

    request.requestLen = phr_parse_request(buffer, bufferSize, (const char**) &(request.method), &(request.methodLen), 
    (const char**) &(request.path), &(request.pathLen), &(request.minorVersion), request.headers, &(request.numHeaders), 0);

    if((int) request.requestLen < 0){
        return -1;
    }

    if((request.methodLen == 3) && (strncmp(request.method, "GET", 3) == 0)){
        if((request.pathLen == strlen(upcheckStr)) && (strncmp(request.path, upcheckStr, strlen(upcheckStr)) == 0)){
            reply->method = upcheck;
        }else if((request.pathLen == strlen(getKeysStr)) && (strncmp(request.path, getKeysStr, strlen(getKeysStr)) == 0)){
            reply->method = getKeys;
        }else{
            return -1;
        }
    }else if((request.methodLen == 4) && (strncmp(request.method, "POST", 4) == 0)){
        getBody(buffer, bufferSize, &request);
        if((request.pathLen == (strlen(signRequestStr) + keySize)) && (strncmp(request.path, signRequestStr, strlen(signRequestStr)) == 0)){
            reply->keyToSign = request.path + strlen(signRequestStr);
                        
            reply->json = request.body;
            reply->jsonLen = request.bodyLen;

            reply->method = sign;        
        }else{
            return -1;
        }
    }else{
        return -1;
    }

    return 0;
}

/*
    Returns size of buffer
*/
int upcheckResponseStr(char* buffer){
    strcpy(buffer, upcheckResponse);
    return strlen(upcheckResponse);
}

/*
    Returns size of buffer
*/
int pknotfoundResponseStr(char* buffer){
    strcpy(buffer, pknf);
    return strlen(pknf);
}

/*
    Returns size of buffer
*/
int getKeysResponseStr(char* buffer, struct boardRequest* request){
    int jsonKeysSize = 6*request->nKeys - 1 + request->nKeys*keySize + 3;
    if(request->nKeys == 0){
        jsonKeysSize = 3;
    }

    strcpy(buffer, getKeysResponse);

    char nKeysStr[100];
    sprintf(nKeysStr, "%d", jsonKeysSize);

    strcat(buffer, nKeysStr);
    strcat(buffer, "\n\n[\n");

    for(int i = 0; i < request->nKeys; ++i){
        strcat(buffer, "\"0x");
        strncat(buffer, request->publicKeys[i], keySize);
        strcat(buffer, "\"");
        if(i + 1 < request->nKeys){
            strcat(buffer, ",");
        }
        strcat(buffer, "\n");
    }
    strcat(buffer, "]");

    return strlen(buffer);
}

/*
    Returns size of buffer
*/
int signResponseStr(char* buffer, struct boardRequest* request){
    cJSON* json = cJSON_Parse(request->json);
    cJSON* signingroot = cJSON_GetObjectItemCaseSensitive(json, "signingRoot");

    char* key = strndup(request->keyToSign, 96);
    char signat[MAXSizeEthereumSignature];//¿Maximum size of ethereum siganture?
    signature(key, signingroot->valuestring, signat);

    char reply[256] = "";
    strcat(reply, "{\"signature\": \"0x");
    strncat(reply, signat, 192);
    strcat(reply, "\"}");
    strcpy(buffer, signResponse);

    int signatureLen = strlen(reply);
    char signatureLenStr[100];
    sprintf(signatureLenStr, "%d", signatureLen);

    strcat(buffer, signatureLenStr);
    strcat(buffer, "\n\n");
    strcat(buffer, reply);

    return strlen(buffer);
}

/*
    On succes returns the number of bytes in buffer
    On error retuns -1
*/
int dumpHttpResponse(char* buffer, struct boardRequest* request){//boardRequest in, buffer out
    switch(request->method){
        case sign:
            if(checkKey(request) == -1){
                return pknotfoundResponseStr(buffer);
            }
            return signResponseStr(buffer, request);
            break;
        case upcheck:
            return upcheckResponseStr(buffer);
            break;
        case getKeys:
            copyKeys(request);
            return getKeysResponseStr(buffer, request);
            break;
        default:
            return -1;
    }
}

#endif
```

## src/secure_partition_interface.c
```c
/*
 * Copyright (c) 2021 Nordic Semiconductor ASA.
 *
 * SPDX-License-Identifier: Apache-2.0
 */

#include <tfm_veneers.h>
#include <tfm_ns_interface.h>

#include "secure_partition_interface.h"

psa_status_t dp_secret_digest(uint32_t secret_index,
			void *p_digest,
			size_t digest_size)
{
	psa_status_t status;
	psa_invec in_vec[] = {
		{ .base = &secret_index, .len = sizeof(secret_index) },
	};

	psa_outvec out_vec[] = {
		{ .base = p_digest, .len = digest_size }
	};

	status = tfm_ns_interface_dispatch(
				(veneer_fn)tfm_dp_secret_digest_req_veneer,
				(uint32_t)in_vec,  IOVEC_LEN(in_vec),
				(uint32_t)out_vec, IOVEC_LEN(out_vec));

	return status;
}

int tfm_get_keystore_size(){
	uint32_t size;
	psa_status_t status;
	psa_invec out_vec[] = {
		{ .base = &size, .len = sizeof(size) },
	};

	status = tfm_ns_interface_dispatch(
				(veneer_fn)tfm_get_keystore_size_req_veneer,
				(uint32_t) NULL,  0,
				(uint32_t)out_vec, IOVEC_LEN(out_vec));

	return size;
}

int tfm_get_free_memory_size(){
	uint32_t size = tfm_ns_interface_dispatch(
				(veneer_fn)tfm_get_free_memory_size_req_veneer,
				(uint32_t) NULL, 0,
				(uint32_t) NULL, 0);

	return size;
}

int tfm_store_pk(char* public_key_hex){
	return 0;
}

int tfm_get_key(uint32_t index, char* public_key_hex){
	psa_status_t status;
	psa_invec in_vec[] = {
		{ .base = &index, .len = sizeof(index) },
	};

	psa_outvec out_vec[] = {
		{ .base = public_key_hex, .len = 96 }
	};

	status = tfm_ns_interface_dispatch(
				(veneer_fn)tfm_get_key_req_veneer,
				(uint32_t)in_vec,  IOVEC_LEN(in_vec),
				(uint32_t)out_vec, IOVEC_LEN(out_vec));

	return status;
}

int tfm_get_keys(char public_keys_hex_store_ns[10][96]){
	psa_status_t status;

	psa_outvec out_vec[] = {
		{ .base = public_keys_hex_store_ns, .len = sizeof(char)*1*96 },
	};

	status = tfm_ns_interface_dispatch(
				(veneer_fn)tfm_get_keys_req_veneer,
				(uint32_t) NULL, 0,
				(uint32_t)out_vec, IOVEC_LEN(out_vec));

	return status;
}

int tfm_secure_keygen(char* info, size_t infosize){
	uint32_t index;
	psa_status_t status;

    psa_invec in_vec[] = {
		{ .base = info, .len = infosize }
	};

	psa_outvec out_vec[] = {
		{ .base = &index, .len = sizeof(index) },
	};

	status = tfm_ns_interface_dispatch(
				(veneer_fn)tfm_secure_keygen_req_veneer,
				(uint32_t)in_vec, IOVEC_LEN(in_vec),
				(uint32_t)out_vec, IOVEC_LEN(out_vec));

	return index; //return status;
}

int tfm_sign_pk(char* pk, char* msg, char* sign){
	psa_status_t status;

    psa_invec in_vec[] = {
		{ .base = pk, .len = /*sizeof(pk)*/97 },
		{ .base = msg, .len = /*sizeof(msg)*/65 }/**/
	};

	psa_outvec out_vec[] = {
		{ .base = sign, .len = /*sizeof(sign)*/193 },
	};

	status = tfm_ns_interface_dispatch(
				(veneer_fn)tfm_sign_pk_req_veneer,
				(uint32_t)in_vec, IOVEC_LEN(in_vec),
				(uint32_t)out_vec, IOVEC_LEN(out_vec));

	/*printk("(tfm_sign_pk) pk: %s\n", pk);
	printk("(tfm_sign_pk) msg: %s\n", msg);
	printk("(tfm_sign_pk) sign: %s\n", sign);
	printk("(tfm_sign_pk) ret: %d\n", status);*/

	return status;
}

int tfm_reset(){
	psa_status_t status;

	status = tfm_ns_interface_dispatch(
				(veneer_fn)tfm_reset_req_veneer,
				(uint32_t) NULL, 0,
				(uint32_t) NULL, 0);

	return status;
}

int tfm_import_sk(char* sk){
	return 0;
}
```

## src/secure_partition_interface.h
```c
/*
 * Copyright (c) 2021 Nordic Semiconductor ASA.
 *
 * SPDX-License-Identifier: Apache-2.0
 */

#include "tfm_api.h"

psa_status_t dp_secret_digest(uint32_t secret_index,
			      void *p_digest,
			      size_t digest_size);
int tfm_get_keystore_size();
int tfm_get_free_memory_size(); // For temporary use
int tfm_store_pk(char* public_key_hex);
int tfm_get_key(uint32_t index, char* public_key_hex);
int tfm_get_keys(char public_keys_hex_store_ns[10][96]);
int tfm_secure_keygen(char* info, size_t infosize);
int tfm_sign_pk(char* pk, char* msg, char* sign);
int tfm_reset();
int tfm_import_sk(char* sk);
```

## src/utils.c
```c
int pk_in_keystore(char * public_key_hex, int offset);
void ikm_sk(char* info);
void sk_to_pk(blst_p1* pk);
void sign_pk(blst_p2* sig, blst_p2* hash);
void reset();
void store_pk(char* public_key_hex);
int get_keystore_size();
void getkeys(char* public_keys_hex_store_ns);

void print_pk(char* public_key_hex){
        printf("0x");
        for(int i = 0; i < 96; i++) {
          printf("%c", public_key_hex[i]);
        }
        printf("\n");
}

void print_sig(char* sig_hex){
        printf("0x");
        for(int i = 0; i < 192; i++) {
          printf("%c", sig_hex[i]);
        }
        printf("\n");
}

void pk_serialize(byte* out, blst_p1 pk){
        blst_p1_compress(out, &pk);
}

void sig_serialize(byte* out2, blst_p2 sig){
        blst_p2_compress(out2, &sig);
}

void get_point_from_msg(blst_p2* hash, uint8_t* msg_bin){
        char dst[] = "BLS_SIG_BLS12381G2_XMD:SHA-256_SSWU_RO_POP"; //IETF BLS Signature V4
        //Obtain the point from a message
        blst_hash_to_g2(hash, msg_bin, 32, dst, sizeof(dst), NULL, 0);
}

int parse(char* str, int len){
        int offset;

        int strl = strlen(str);

        if((str[0] == '0') && (str[1] == 'x')){
            if(strl == len+2){
                 offset = 2;
            }else{
                offset = -1;
            }
        }else{
            if(strl == len){
                 offset = 0;
            }else{
                offset = -1;
            }
        }

        return offset;
}

int char_chk(char* aux, int len){
        int error = 0;

        for(int i = 0; (i < len) && (error == 0); i++){
            if(!((aux[i] >= '0' && aux[i] <= '9') || (aux[i] >= 'a' && aux[i] <= 'f') || (aux[i] >= 'A' && aux[i] <= 'F'))){
                error = 1;
            }
        }

        return error;
}

int pk_parse(char* pk_hex, blst_p1_affine* pk){
        byte pk_bin[48];
        int offset = parse(pk_hex, 96);
        int error = 0;

        if(offset == -1){
            printf("Incorrect public key length. It must be 96 characters long.\n");
            error = 1;
        }else{
            if(char_chk(pk_hex + offset, 96)){
                printf("Public key contains incorrect characters.\n");
                error = 1;
            }else{
                if(hex2bin(pk_hex + offset, 96, pk_bin, 48) == 0) {
                    printf("Failed converting public key to binary array\n");
                    error = 1;
                }else{
                    blst_p1_uncompress(pk, pk_bin);
                }
            }
        }
        
        return error;
}

int msg_parse(char* msg, uint8_t* msg_bin){

        int offset = parse(msg, 64);
        int error = 0;

        if(offset == -1){
            printf("Incorrect message length. It must be 64 characters long.\n");
            error = 1;
        }else{
            if(char_chk(msg + offset, 64)){
                printf("Message contains incorrect characters.\n");
                error = 1;
            }else{
                if(hex2bin(msg + offset, 64, msg_bin, 32) == 0) {
                    printf("Failed converting message to binary array\n");
                    error = 1;
                }
            }
        }

        return error;
}

int sig_parse(char* sig_hex, blst_p2_affine* sig){
        byte sig_bin[96];
        int offset = parse(sig_hex, 192);
        int error = 0;

        if(offset == -1){
            printf("Incorrect signature length. It must be 192 characters long.\n");
            error = 1;
        }else{
            if(char_chk(sig_hex + offset, 192)){
                printf("Signature contains incorrect characters.\n");
                error = 1;
            }else{
                if(hex2bin(sig_hex + offset, 192, sig_bin, 96) == 0) {
                    printf("Failed converting signature to binary array\n");
                    error = 1;
                }else{
                    blst_p2_uncompress(sig, sig_bin);
                }
            }
        }
        return error;
}
```
