## shell_module/build_nrf5340dk_nrf5340_cpuappns/Kconfig/Kconfig.shield
```kconfig
osource "C:/ncs/v1.6.0/nrf/boards/shields/*/Kconfig.shield"
osource "C:/ncs/v1.6.0/zephyr/boards/shields/*/Kconfig.shield"
```

## shell_module/build_nrf9160dk_nrf9160ns/Kconfig/Kconfig.modules
```kconfig
osource "C:/Users/pablo/ncs/v1.4.99-dev1/nrf/Kconfig.nrf"

osource "C:/Users/pablo/ncs/v1.4.99-dev1/bootloader/mcuboot/zephyr/Kconfig"

osource "C:/Users/pablo/ncs/v1.4.99-dev1/nrfxlib/Kconfig.nrfxlib"
```

## shell_module/build_nrf9160dk_nrf9160ns/spm/Kconfig/Kconfig.shield.defconfig
```kconfig
osource "C:/Users/pablo/ncs/v1.4.99-dev1/nrf/boards/shields/*/Kconfig.defconfig"
osource "C:/Users/pablo/ncs/v1.4.99-dev1/zephyr/boards/shields/*/Kconfig.defconfig"
```

## shell_module_basic/build_nrf5340dk_nrf5340_cpuappns/spm/Kconfig/Kconfig.modules
```kconfig
menu "nrf (C:\ncs\v1.6.0\nrf)"
osource "C:/ncs/v1.6.0/nrf/Kconfig.nrf"
config ZEPHYR_NRF_MODULE
	bool
	default y
endmenu
menu "mcuboot (C:\ncs\v1.6.0\bootloader\mcuboot)"
osource "$(ZEPHYR_MCUBOOT_KCONFIG)"
config ZEPHYR_MCUBOOT_MODULE
	bool
	default y
endmenu
menu "trusted-firmware-m (C:\ncs\v1.6.0\modules\tee\tfm)"
osource "$(ZEPHYR_TRUSTED_FIRMWARE_M_KCONFIG)"
config ZEPHYR_TRUSTED_FIRMWARE_M_MODULE
	bool
	default y
endmenu
menu "cjson (C:\ncs\v1.6.0\modules\lib\cjson)"
osource "$(ZEPHYR_CJSON_KCONFIG)"
config ZEPHYR_CJSON_MODULE
	bool
	default y
endmenu
menu "pelion-dm (C:\ncs\v1.6.0\modules\lib\pelion-dm)"
osource "C:/ncs/v1.6.0/modules/lib/pelion-dm/zephyr/Kconfig"
config ZEPHYR_PELION_DM_MODULE
	bool
	default y
endmenu
menu "cddl-gen (C:\ncs\v1.6.0\modules\lib\cddl-gen)"
osource "$(ZEPHYR_CDDL_GEN_KCONFIG)"
config ZEPHYR_CDDL_GEN_MODULE
	bool
	default y
endmenu
menu "memfault-firmware-sdk (C:\ncs\v1.6.0\modules\lib\memfault-firmware-sdk)"
osource "C:/ncs/v1.6.0/modules/lib/memfault-firmware-sdk/ports/zephyr/Kconfig"
config ZEPHYR_MEMFAULT_FIRMWARE_SDK_MODULE
	bool
	default y
endmenu
menu "hal_nordic (C:\ncs\v1.6.0\modules\hal\nordic)"
osource "$(ZEPHYR_HAL_NORDIC_KCONFIG)"
config ZEPHYR_HAL_NORDIC_MODULE
	bool
	default y
endmenu
menu "mbedtls (C:\ncs\v1.6.0\modules\crypto\mbedtls)"
osource "$(ZEPHYR_MBEDTLS_KCONFIG)"
config ZEPHYR_MBEDTLS_MODULE
	bool
	default y
endmenu
menu "TraceRecorder (C:\ncs\v1.6.0\modules\debug\TraceRecorder)"
osource "C:/ncs/v1.6.0/modules/debug/TraceRecorder/kernelports/Zephyr/Kconfig"
config ZEPHYR_TRACERECORDER_MODULE
	bool
	default y
endmenu
menu "nrfxlib (C:\ncs\v1.6.0\nrfxlib)"
osource "C:/ncs/v1.6.0/nrfxlib/Kconfig.nrfxlib"
config ZEPHYR_NRFXLIB_MODULE
	bool
	default y
endmenu
menu "connectedhomeip (C:\ncs\v1.6.0\modules\lib\matter)"
osource "C:/ncs/v1.6.0/modules/lib/matter/config/nrfconnect/chip-module/Kconfig"
config ZEPHYR_CONNECTEDHOMEIP_MODULE
	bool
	default y
endmenu
```

## shell_module_basic/build_nrf5340dk_nrf5340_cpuappns/spm/Kconfig/Kconfig.shield.defconfig
```kconfig
osource "C:/ncs/v1.6.0/nrf/boards/shields/*/Kconfig.defconfig"
osource "C:/ncs/v1.6.0/zephyr/boards/shields/*/Kconfig.defconfig"
```

## shell_module_basic/build_nrf5340dk_nrf5340_cpuappns/spm/Kconfig/Kconfig.soc.arch
```kconfig
osource "C:/ncs/v1.6.0/zephyr/soc/$(ARCH)/Kconfig"
osource "C:/ncs/v1.6.0/zephyr/soc/$(ARCH)/*/Kconfig"
```

## shell_module_basic/build_nrf9160dk_nrf9160ns/Kconfig/Kconfig.shield
```kconfig
osource "C:/Users/pablo/ncs/v1.4.99-dev1/nrf/boards/shields/*/Kconfig.shield"
osource "C:/Users/pablo/ncs/v1.4.99-dev1/zephyr/boards/shields/*/Kconfig.shield"
```
